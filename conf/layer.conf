## conf/layer.conf
```bitbake
# We have a conf and classes directory, add to BBPATH
BBPATH .= ":${LAYERDIR}"

# We have recipes-* directories, add to BBFILES
BBFILES += "${LAYERDIR}/recipes-*/*/*.bb \\
            ${LAYERDIR}/recipes-*/*/*.bbappend"

BBFILE_COLLECTIONS += "irobot-mt"
BBFILE_PATTERN_irobot-mt = "^${LAYERDIR}/"
BBFILE_PRIORITY_irobot-mt = "6"
LAYERSERIES_COMPAT_irobot-mt = "thud warrior"
```
